## firmware/connection_validation/sdkconfig.defaults
```kconfig
CONFIG_IDF_TARGET="esp32s3"
CONFIG_ESP_CONSOLE_UART_DEFAULT=y
CONFIG_ESP_CONSOLE_UART_NUM=0
CONFIG_ESP_CONSOLE_UART_BAUDRATE=115200
CONFIG_TINYUSB_CDC_ENABLED=y
CONFIG_TINYUSB_CDC_COUNT=1
CONFIG_TINYUSB_HID_COUNT=0
CONFIG_USB_HOST_HUBS_SUPPORTED=y
CONFIG_ESPTOOLPY_FLASHSIZE_8MB=y
```

## firmware/dual_proxy/sdkconfig.defaults
```kconfig
CONFIG_IDF_TARGET="esp32s3"
CONFIG_FREERTOS_HZ=1000
CONFIG_ESP_CONSOLE_UART_CUSTOM=y
CONFIG_ESP_CONSOLE_UART_CUSTOM_NUM_0=y
CONFIG_ESP_CONSOLE_UART_NUM=0
CONFIG_ESP_CONSOLE_UART_BAUDRATE=921600
CONFIG_ESP_CONSOLE_UART_TX_GPIO=43
CONFIG_ESP_CONSOLE_UART_RX_GPIO=44
CONFIG_TINYUSB_CDC_ENABLED=y
CONFIG_TINYUSB_CDC_COUNT=1
CONFIG_TINYUSB_HID_COUNT=4
CONFIG_USB_HOST_HUBS_SUPPORTED=y
CONFIG_ESPTOOLPY_FLASHSIZE_8MB=y
```

## firmware/main/Kconfig.projbuild
```kconfig
menu "Dual HID Bridge"

config DUAL_PROXY_USE_CHERRYUSB
	bool "在 M 侧使用 CherryUSB HID Host 后端"
	default y
	depends on IDF_TARGET_ESP32S3
	help
	  默认由 CherryUSB 管理 M 侧物理 HID Host；P 侧电脑 USB Device 仍由 TinyUSB 管理。
	  关闭此选项可显式回退到 ESP-IDF USB Host。CherryUSB 后端不会自动断电重启 USB 根端口。

endmenu
```

## firmware/sdkconfig.defaults
```kconfig
CONFIG_IDF_TARGET="esp32s3"
CONFIG_FREERTOS_HZ=1000
CONFIG_ESP_CONSOLE_UART_CUSTOM=y
CONFIG_ESP_CONSOLE_UART_CUSTOM_NUM_0=y
CONFIG_ESP_CONSOLE_UART_NUM=0
CONFIG_ESP_CONSOLE_UART_BAUDRATE=921600
CONFIG_ESP_CONSOLE_UART_TX_GPIO=43
CONFIG_ESP_CONSOLE_UART_RX_GPIO=44
CONFIG_TINYUSB_CDC_ENABLED=y
CONFIG_TINYUSB_CDC_COUNT=1
CONFIG_TINYUSB_HID_COUNT=4
CONFIG_USB_HOST_HUBS_SUPPORTED=y
# 双板主镜像默认使用 CherryUSB 物理鼠标 Host；电脑侧 Device 路径仍使用 TinyUSB。
CONFIG_DUAL_PROXY_USE_CHERRYUSB=y
CONFIG_CHERRYUSB=y
CONFIG_CHERRYUSB_HOST=y
CONFIG_CHERRYUSB_HOST_DWC2_ESP=y
CONFIG_CHERRYUSB_HOST_HID=y
CONFIG_USBHOST_CONTROL_TRANSFER_TIMEOUT=500
# CONFIG_CHERRYUSB_DEVICE is not set
# CONFIG_CHERRYUSB_HOST_MSC is not set
# CONFIG_CHERRYUSB_HOST_CDC_ACM is not set
CONFIG_ESPTOOLPY_FLASHSIZE_4MB=y
```

## firmware/usb_bandwidth_probe/main/Kconfig.projbuild
```kconfig
menu "USB throughput probe"
    config USB_PROBE_VENDOR
        bool "Use Vendor Bulk / WinUSB instead of CDC"
        default n
endmenu
```

## firmware/usb_bandwidth_probe/sdkconfig.defaults
```kconfig
CONFIG_IDF_TARGET="esp32s3"
CONFIG_ESPTOOLPY_FLASHSIZE_16MB=y
CONFIG_ESP_DEFAULT_CPU_FREQ_MHZ_240=y
CONFIG_TINYUSB_CDC_ENABLED=y
CONFIG_TINYUSB_CDC_COUNT=1
CONFIG_TINYUSB_CDC_RX_BUFSIZE=8192
CONFIG_TINYUSB_CDC_TX_BUFSIZE=16384
CONFIG_TINYUSB_CDC_EP_BUFSIZE=512
CONFIG_TINYUSB_HID_COUNT=0
CONFIG_ESP_CONSOLE_UART_DEFAULT=y
CONFIG_LOG_DEFAULT_LEVEL_WARN=y
```
